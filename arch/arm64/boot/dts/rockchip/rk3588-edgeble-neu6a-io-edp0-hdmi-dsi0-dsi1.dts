// SPDX-License-Identifier: (GPL-2.0+ OR MIT)
/*
 * Copyright (c) 2023 Edgeble AI Technologies Pvt. Ltd.
 */

/dts-v1/;

#include "rk3588.dtsi"
#include "rk3588-edgeble-neu6.dtsi"

/ {
	model = "Edgeble Neu6A-EDP0-HDMI1-DSI0/1";
	compatible = "edgeble,neural-compute-module-6a-io", "rockchip,rk3588";
};

#include "rk3588-edgeble-neu6b-io-edp0-hdmi1-dsi0-dsi1.dtsi"
